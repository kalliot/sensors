## main/Kconfig.projbuild
```kconfig
menu "Sensors Configuration"

    config SETUPLED_GPIO
        int "Setup led gpio"
        range 0 36
        default 12
        help
            This led is lit when config web ap server is active.

    config WLANSTATUS_GPIO
        int "Wlan status led gpio"
        range 0 36
        default 14
        help
            This led is lit when wlan is connected.

    config MQTTSTATUS_GPIO
        int "MQTT status led gpio"
        range 0 36
        default 13
        help
            This led is lit when mqtt is in connected state.

    config ESP_WIFI_SSID
        string "WiFi SSID"
        default "myssid"
        help
            SSID (network name) for the example to connect to.

    config ESP_WIFI_PASSWORD
        string "WiFi Password"
        default "mypassword"
        help
            WiFi password (WPA or WPA2) for the example to use.

    config ESP_WIFI_CHANNEL
        int "WiFi Channel"
        range 1 13
        default 1
        help
            WiFi channel (network channel) for the example to use.

    config ESP_MAX_STA_CONN
        int "Maximal STA connections"
        default 1
        help
            Max number of the STA connects to AP.
endmenu
```
